## boards/sharp/zaurus/sl_c3x00/Kconfig.zaurus_sl_c3200
```kconfig
# Copyright (c) 2026 Takayuki Goto
# SPDX-License-Identifier: Apache-2.0

config BOARD_ZAURUS_SL_C3200
	select SOC_PXA270
```

## boards/sharp/zaurus/sl_c3x00/board.yml
```yaml
boards:
  - name: zaurus_sl_c3200
    full_name: Sharp Zaurus SL-C3200 (Terrier)
    vendor: sharp
    socs:
      - name: pxa270
```

## drivers/display/Kconfig.corgi_lcd
```kconfig
# Copyright (c) 2026 Takayuki Goto
# SPDX-License-Identifier: Apache-2.0

config CORGI_LCD
	bool "Sharp corgi LCD timing generator and backlight"
	default y
	depends on DT_HAS_SHARP_CORGI_LCD_ENABLED
	select SPI
	select GPIO
	help
	  Powers up the panel of the Zaurus C7x0/Cxx00 and turns its
	  backlight on.

config CORGI_LCD_INIT_PRIORITY
	int "corgi LCD init priority"
	default 86
	depends on CORGI_LCD
	help
	  After the LCD controller, which runs at DISPLAY_INIT_PRIORITY, and
	  after SPI and the GPIO expanders it uses.
```

## drivers/display/Kconfig.pxa_lcd
```kconfig
# Copyright (c) 2026 Takayuki Goto
# SPDX-License-Identifier: Apache-2.0

config DISPLAY_PXA_LCD
	bool "PXA27x LCD controller"
	default y
	depends on DT_HAS_INTEL_PXA27X_LCD_ENABLED
	select CACHE_MANAGEMENT if CPU_HAS_DCACHE
	help
	  16 bpp framebuffer on the PXA27x LCD controller.
```

## drivers/gpio/Kconfig.pxa
```kconfig
# Copyright (c) 2026 Takayuki Goto
# SPDX-License-Identifier: Apache-2.0

config GPIO_PXA
	bool "PXA2xx GPIO"
	default y
	depends on DT_HAS_INTEL_PXA2XX_GPIO_ENABLED
	help
	  On-chip GPIO of the PXA2xx, one device per 32-line bank.
```

## drivers/gpio/Kconfig.sharp_scoop
```kconfig
# Copyright (c) 2026 Takayuki Goto
# SPDX-License-Identifier: Apache-2.0

config GPIO_SHARP_SCOOP
	bool "Sharp SCOOP GPIO"
	default y
	depends on DT_HAS_SHARP_SCOOP_ENABLED
	help
	  GPIO port of the Sharp SCOOP companion chip on the Zaurus, which
	  carries the LEDs and the backlight controls.
```

## drivers/i2c/Kconfig.pxa
```kconfig
# Copyright (c) 2026 Takayuki Goto
# SPDX-License-Identifier: Apache-2.0

config I2C_PXA
	bool "PXA2xx I2C controller"
	default y
	depends on DT_HAS_INTEL_PXA2XX_I2C_ENABLED
	help
	  Polled bus master on the PXA2xx I2C and PWR_I2C controllers.
```

## drivers/spi/Kconfig.pxa_ssp
```kconfig
# Copyright (c) 2026 Takayuki Goto
# SPDX-License-Identifier: Apache-2.0

config SPI_PXA_SSP
	bool "PXA2xx SSP as SPI controller"
	default y
	depends on DT_HAS_INTEL_PXA2XX_SSP_ENABLED
	select GPIO
	help
	  Polled SPI on a PXA2xx SSP port, with GPIO chip selects.
```

## drivers/timer/Kconfig.pxa_os_timer
```kconfig
# Copyright (c) 2026 Takayuki Goto
# SPDX-License-Identifier: Apache-2.0

config PXA_OS_TIMER
	bool "PXA2xx OS timer"
	default y
	depends on DT_HAS_INTEL_PXA2XX_TIMER_ENABLED
	help
	  Kernel tick source built on the PXA2xx OS timer (OSCR/OSMR0).
```

## dts/bindings/cpu/intel,xscale.yaml
```yaml
# Copyright (c) 2026 Takayuki Goto
# SPDX-License-Identifier: Apache-2.0

description: Intel/Marvell XScale CPU

compatible: "intel,xscale"

include: cpu.yaml
```

## dts/bindings/display/intel,pxa27x-lcd.yaml
```yaml
# Copyright (c) 2026 Takayuki Goto
# SPDX-License-Identifier: Apache-2.0

description: |
  Intel/Marvell PXA27x LCD controller driving a parallel active (TFT) panel
  from a 16 bpp RGB565 framebuffer in SDRAM.

  The panel timing comes from a "display-timings" child node with the
  zephyr,panel-timing properties. The pixel clock divider is worked out at
  boot from the LCD clock the CPU is running at, rounding the panel clock
  down.

compatible: "intel,pxa27x-lcd"

include: [display-controller.yaml, base.yaml]

properties:
  reg:
    required: true

  cken-bit:
    type: int
    required: true
    description: Bit number of the LCD controller clock enable in CKEN.

  alternate-mapping:
    type: boolean
    description: |
      Set LCCR0[LDDALT], the alternate mapping of 16 bpp data onto the
      LDD pins that Sharp's Zaurus panels use.
```

## dts/bindings/display/sharp,corgi-lcd.yaml
```yaml
# Copyright (c) 2026 Takayuki Goto
# SPDX-License-Identifier: Apache-2.0

description: |
  LCD timing generator and backlight of the Sharp Zaurus C7x0 and Cxx00
  (Linux: corgi-lcd).

  The timing generator takes one byte per register write, three address
  bits over five data bits, and powers the panel up in a fixed sequence. It
  also sets five of the six backlight duty bits; the sixth and the backlight
  enable are GPIOs.

compatible: "sharp,corgi-lcd"

include: [spi-device.yaml]

properties:
  backlight-on-gpios:
    type: phandle-array
    required: true
    description: Backlight enable.

  backlight-cont-gpios:
    type: phandle-array
    required: true
    description: Bit 5 of the backlight duty value.

  brightness:
    type: int
    default: 0x1f
    description: |
      Backlight level at boot, 0 (off) to 0x2f, on Linux's corgi_bl scale.
      Linux's default for the C3x00 is 0x1f.

  qvga:
    type: boolean
    description: Run the panel at 240x320 instead of 480x640.
```

## dts/bindings/gpio/intel,pxa2xx-gpio.yaml
```yaml
# Copyright (c) 2026 Takayuki Goto
# SPDX-License-Identifier: Apache-2.0

description: |
  One 32-line bank of the Intel/Marvell PXA2xx GPIO controller.

  reg is the bank's GPLR. The bank's GPDR, GPSR and GPCR sit 0x0c, 0x18 and
  0x24 above it, in all four banks of a PXA27x (GPLR0-2 at 0x00-0x08, GPLR3
  at 0x100), so one node per bank needs nothing else.

  Configuring a line through this driver also routes it to plain GPIO
  (alternate function 0).

compatible: "intel,pxa2xx-gpio"

include: [gpio-controller.yaml, base.yaml]

properties:
  reg:
    required: true

  ngpios:
    required: true

  "#gpio-cells":
    const: 2

gpio-cells:
  - pin
  - flags
```

## dts/bindings/gpio/sharp,scoop.yaml
```yaml
# Copyright (c) 2026 Takayuki Goto
# SPDX-License-Identifier: Apache-2.0

description: |
  Sharp SCOOP general purpose I/O.

  SCOOP is the companion ASIC on the Sharp Zaurus that also runs the PCMCIA
  sockets. Only its GPIO port is driven here: twelve lines, PA11 to PA22, held
  in bits 1 to 12 of 16-bit registers. Pin n of this controller is bit n + 1,
  the same numbering Linux uses, so pin 0 is PA11.

compatible: "sharp,scoop"

include: [gpio-controller.yaml, base.yaml]

properties:
  reg:
    required: true

  ngpios:
    required: true

  "#gpio-cells":
    const: 2

gpio-cells:
  - pin
  - flags
```

## dts/bindings/i2c/intel,pxa2xx-i2c.yaml
```yaml
# Copyright (c) 2026 Takayuki Goto
# SPDX-License-Identifier: Apache-2.0

description: |
  Intel/Marvell PXA2xx I2C controller, either the general purpose one or the
  power manager's (PWR_I2C), as a polled bus master.

  reg starts at IBMR (0x40301680 and 0x40f00180 on the PXA27x).

compatible: "intel,pxa2xx-i2c"

include: [i2c-controller.yaml, base.yaml]

properties:
  reg:
    required: true

  cken-bit:
    type: int
    required: true
    description: Bit number of this controller's clock enable in CKEN.

  pwr-i2c:
    type: boolean
    description: |
      The power manager's controller. Its pins are dedicated but stay off
      until PCFR[PI2C_EN] is set, which the driver does.
```

## dts/bindings/interrupt-controller/intel,pxa2xx-intc.yaml
```yaml
# Copyright (c) 2026 Takayuki Goto
# SPDX-License-Identifier: Apache-2.0

description: |
  Intel/Marvell PXA2xx interrupt controller.

  PXA25x/26x expose a single 32-entry bank; PXA27x adds a second bank for
  interrupt sources 32 and up.

compatible: "intel,pxa2xx-intc"

include: [interrupt-controller.yaml, base.yaml]

properties:
  reg:
    required: true

  "#interrupt-cells":
    const: 2

  num-irqs:
    type: int
    required: true
    description: Number of interrupt sources implemented by this controller.

interrupt-cells:
  - irq
  - priority
```

## dts/bindings/spi/intel,pxa2xx-ssp.yaml
```yaml
# Copyright (c) 2026 Takayuki Goto
# SPDX-License-Identifier: Apache-2.0

description: |
  Intel/Marvell PXA2xx SSP port, used as an SPI controller.

  The driver polls, moves 4 to 16 bit words, and drives chip selects through
  cs-gpios only, as the Zaurus does. The bit clock is a 13 MHz divided by
  1 to 4096.

compatible: "intel,pxa2xx-ssp"

include: [spi-controller.yaml, base.yaml]

properties:
  reg:
    required: true

  cken-bit:
    type: int
    required: true
    description: Bit number of this port's clock enable in CKEN.
```

## dts/bindings/timer/intel,pxa2xx-timer.yaml
```yaml
# Copyright (c) 2026 Takayuki Goto
# SPDX-License-Identifier: Apache-2.0

description: |
  Intel/Marvell PXA2xx OS timer.

  OSCR is a free running 32-bit up counter clocked at 3.25 MHz on PXA27x; the kernel
  tick is generated from a match on OSMR0.

compatible: "intel,pxa2xx-timer"

include: base.yaml

properties:
  reg:
    required: true

  interrupts:
    required: true

  clock-frequency:
    type: int
    required: true
    description: OSCR input clock frequency, in Hz.
```

## soc/intel/intel_pxa/Kconfig
```kconfig
# Copyright (c) 2026 Takayuki Goto
# SPDX-License-Identifier: Apache-2.0

if SOC_FAMILY_INTEL_PXA

rsource "*/Kconfig"

endif # SOC_FAMILY_INTEL_PXA
```

## soc/intel/intel_pxa/Kconfig.soc
```kconfig
# Copyright (c) 2026 Takayuki Goto
# SPDX-License-Identifier: Apache-2.0

config SOC_FAMILY_INTEL_PXA
	bool

config SOC_FAMILY
	default "intel_pxa" if SOC_FAMILY_INTEL_PXA

rsource "*/Kconfig.soc"
```

## soc/intel/intel_pxa/pxa27x/Kconfig
```kconfig
# Copyright (c) 2026 Takayuki Goto
# SPDX-License-Identifier: Apache-2.0

config SOC_SERIES_PXA27X
	select ARM
	select CPU_XSCALE
	select SOC_EARLY_INIT_HOOK
```

## soc/intel/intel_pxa/pxa27x/Kconfig.soc
```kconfig
# Copyright (c) 2026 Takayuki Goto
# SPDX-License-Identifier: Apache-2.0

config SOC_SERIES_PXA27X
	bool
	select SOC_FAMILY_INTEL_PXA
	help
	  Intel/Marvell PXA27x (XScale, ARMv5TE) application processors.

config SOC_SERIES
	default "pxa27x" if SOC_SERIES_PXA27X

config SOC_PXA270
	bool
	select SOC_SERIES_PXA27X
	help
	  Intel/Marvell PXA270

config SOC
	default "pxa270" if SOC_PXA270
```
